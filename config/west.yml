## config/west.yml
```yaml
manifest:
  remotes:
    - name: GerardoNevarez
      url-base: https://github.com/GerardoNevarez
  projects:
    - name: zmk
      remote: GerardoNevarez
      revision: default_rebound_rebased_2.5
      import: app/west.yml
  self:
    path: config
```
